## Documentation/devicetree/bindings/net/allwinner,sun7i-a20-gmac.yaml
```yaml
# SPDX-License-Identifier: GPL-2.0
%YAML 1.2
---
$id: http://devicetree.org/schemas/net/allwinner,sun7i-a20-gmac.yaml#
$schema: http://devicetree.org/meta-schemas/core.yaml#

title: Allwinner A20 GMAC Device Tree Bindings

allOf:
  - $ref: "snps,dwmac.yaml#"

maintainers:
  - Chen-Yu Tsai <wens@csie.org>
  - Maxime Ripard <mripard@kernel.org>

properties:
  compatible:
    const: allwinner,sun7i-a20-gmac

  reg:
    maxItems: 1

  interrupts:
    maxItems: 1

  interrupt-names:
    const: macirq

  clocks:
    items:
      - description: GMAC main clock

      # Deprecated
      - description: TX clock

  clock-names:
    items:
      - const: stmmaceth

      # Deprecated
      - const: allwinner_gmac_tx

  phy-supply:
    description:
      PHY regulator

  syscon:
    $ref: /schemas/types.yaml#definitions/phandle
    description:
      Phandle to the device containing the GMAC clock register

required:
  - compatible
  - reg
  - interrupts
  - interrupt-names
  - clocks
  - clock-names
  - phy-mode
  - syscon

unevaluatedProperties: false

examples:
  - |
    gmac: ethernet@1c50000 {
        compatible = "allwinner,sun7i-a20-gmac";
        syscon = <&syscon>;
        reg = <0x01c50000 0x10000>;
        interrupts = <0 85 1>;
        interrupt-names = "macirq";
        clocks = <&ahb_gates 49>;
        clock-names = "stmmaceth";
        phy-mode = "mii";
    };

...
```
